## config/boards/shields/may_pad/Kconfig.defconfig
```kconfig
# Copyright (c) 2021 The ZMK Contributors
# SPDX-License-Identifier: MIT

if SHIELD_MAY_PAD

config ZMK_KEYBOARD_NAME
    default "May_Pad"

endif
```

## config/boards/shields/may_pad/Kconfig.shield
```kconfig
# Copyright (c) 2021 The ZMK Contributors
# SPDX-License-Identifier: MIT

config SHIELD_MAY_PAD
    def_bool $(shields_list_contains,may_pad)
```
